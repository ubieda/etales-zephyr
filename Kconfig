## Kconfig
```kconfig
# Copyright (c) 2024 Luis Ubieda.
# SPDX-License-Identifier: Apache-2.0

menu "Embedded Tales - Zephyr"

rsource "subsys/Kconfig"

endmenu
```

## boards/arm/croxel_cx1763_nrf52840/Kconfig.defconfig
```kconfig
# Copyright (c) 2024 Luis Ubieda
# SPDX-License-Identifier: Apache-2.0

if BOARD_CROXEL_CX1763_NRF52840

config BOARD
	default "croxel_cx1763_nrf52840"

config BT_CTLR
	default BT

endif # BOARD_CROXEL_CX1763_NRF52840
```

## boards/arm/croxel_cx1825_nrf52840/Kconfig.board
```kconfig
# Copyright (c) 2024 Luis Ubieda
# SPDX-License-Identifier: Apache-2.0

config BOARD_CROXEL_CX1825_NRF52840
	bool "Croxel CX1825 NRF52840"
	depends on SOC_NRF52840_QIAA
```

## boards/arm/croxel_cx1825_nrf52840/croxel_cx1825_nrf52840_defconfig
```kconfig
# Copyright (c) 2024 Luis Ubieda
# SPDX-License-Identifier: Apache-2.0

CONFIG_SOC_SERIES_NRF52X=y
CONFIG_SOC_NRF52840_QIAA=y
CONFIG_BOARD_CROXEL_CX1825_NRF52840=y

# Enable MPU
CONFIG_ARM_MPU=y

# Enable hardware stack protection
CONFIG_HW_STACK_PROTECTION=y

# enable GPIO
CONFIG_GPIO=y

CONFIG_USB_DEVICE_STACK=y
CONFIG_USB_DEVICE_INITIALIZE_AT_BOOT=y

# Console over USB CDC-ACM
CONFIG_SERIAL=y
CONFIG_CONSOLE=y
CONFIG_UART_CONSOLE=y
CONFIG_UART_INTERRUPT_DRIVEN=y
CONFIG_UART_LINE_CTRL=y
```

## boards/croxel/croxel_cx1763/Kconfig.croxel_cx1763
```kconfig
# Copyright (c) 2024 Luis Ubieda
# SPDX-License-Identifier: Apache-2.0

config BOARD_CROXEL_CX1763
	bool "Croxel CX1763 NRF52840"
	select SOC_NRF52840_QIAA
```

## subsys/motion_detection/Kconfig
```kconfig
menuconfig MOTION_DETECTION
	bool "Enable Motion Detection"

if MOTION_DETECTION

config MOTION_DETECTION_THREAD_STACK_SIZE
	int "Motion Detection Thread Stack Size"
	default 1024

config MOTION_DETECTION_THREAD_PRIO
	int "Motion Detection Thread Priority"
	default 9

endif
```

## subsys/shell/Kconfig
```kconfig
# Copyright (c) 2024 Luis Ubieda.
# SPDX-License-Identifier: Apache-2.0

menuconfig SHELL
	bool "Shell"

if SHELL

rsource "backends/Kconfig"

endif # SHELL
```

## subsys/shell/backends/Kconfig
```kconfig
# Copyright (c) 2024 Croxel, Inc.
# SPDX-License-Identifier: Apache-2.0

menuconfig SHELL_BACKENDS
	bool "Shell backends"

if SHELL_BACKENDS

config SHELL_BACKEND_BT
	bool "Bluetooth backend (BLE)"
	depends on BT
	help
	  Enable Bluetooth backend.

if SHELL_BACKEND_BT

config SHELL_PROMPT_BT
	string "Displayed prompt name"
	default "bt:~$ "

module = SHELL_BACKEND_BT
default-timeout = 100
source "subsys/shell/Kconfig.template.shell_log_queue_timeout"

default-size = 10
source "subsys/shell/Kconfig.template.shell_log_queue_size"

choice
	prompt "Initial log level limit"
	default SHELL_BACKEND_BT_LOG_LEVEL_NONE

config SHELL_BACKEND_BT_LOG_LEVEL_DEFAULT
	bool "System limit (LOG_MAX_LEVEL)"

config SHELL_BACKEND_BT_LOG_LEVEL_DBG
	bool "Debug"

config SHELL_BACKEND_BT_LOG_LEVEL_INF
	bool "Info"

config SHELL_BACKEND_BT_LOG_LEVEL_WRN
	bool "Warning"

config SHELL_BACKEND_BT_LOG_LEVEL_ERR
	bool "Error"

config SHELL_BACKEND_BT_LOG_LEVEL_NONE
	bool "None"

endchoice

config SHELL_PRINTF_BUFF_SIZE
	default 256 if SHELL_BACKEND_BT
	#FIXME: Verify max notification size.

config SHELL_BACKEND_BT_LOG_LEVEL
	int
	default 0 if SHELL_BACKEND_BT_LOG_LEVEL_NONE
	default 1 if SHELL_BACKEND_BT_LOG_LEVEL_ERR
	default 2 if SHELL_BACKEND_BT_LOG_LEVEL_WRN
	default 3 if SHELL_BACKEND_BT_LOG_LEVEL_INF
	default 4 if SHELL_BACKEND_BT_LOG_LEVEL_DBG
	default 5 if SHELL_BACKEND_BT_LOG_LEVEL_DEFAULT

module = SHELL_BT
module-str = BT shell backend
source "subsys/logging/Kconfig.template.log_config"

endif # SHELL_BACKEND_BT

endif # SHELL_BACKENDS
```

## west.yml
```yaml
manifest:
  projects:
    - name: zephyr
      revision: 92e0d0b
      url: https://github.com/zephyrproject-rtos/zephyr
      import: true

  self:
    path: modules/lib/etales-zephyr
```
